## sw/arm/meta-zybo-agh/conf/distro/include/zybo-agh.inc
```bitbake
DISTRO_VERSION_MAJOR ?= "1"
DISTRO_VERSION_MINOR ?= "0"
DISTRO_VERSION_PATCH ?= "0"
DISTRO_VERSION = " \
    ${DISTRO_VERSION_MAJOR}. \
    ${DISTRO_VERSION_MINOR}. \
    ${DISTRO_VERSION_PATCH} \
"
DISTRO_FEATURES:remove = "eudev"
DISTRO_FEATURES:append = " \
    systemd \
    usrmerge \
"
DISTRO_FEATURES_BACKFILL_CONSIDERED:append = " \
    sysvinit \
"
PREFERRED_PROVIDER_virtual/kernel = "linux-xlnx"
PREFERRED_PROVIDER_virtual/bootloader = "u-boot-xlnx"

VIRTUAL-RUNTIME_init_manager = "systemd"
VIRTUAL-RUNTIME_initscripts = "systemd-compat-units"
VIRTUAL-RUNTIME_login_manager = "shadow-base"
VIRTUAL-RUNTIME_dev_manager = "systemd"
```

## sw/arm/meta-zybo-agh/conf/distro/zybo-agh-poky.conf
```bitbake
require conf/distro/poky.conf
require include/zybo-agh.inc

DISTRO = "zybo-agh-poky"
DISTRO_NAME = "zybo-agh linux (zybo-agh-poky)"
```

## sw/arm/meta-zybo-agh/conf/layer.conf
```bitbake
BBPATH .= ":${LAYERDIR}"
BBFILES:append = " \
    ${LAYERDIR}/recipes*/*/*.bb \
    ${LAYERDIR}/recipes*/*/*.bbappend \
"
BBFILE_COLLECTIONS:append = " meta-zybo-agh "
BBFILE_PATTERN_meta-zybo-agh := "^${LAYERDIR}/"
BBFILES_PRIORITY_meta-zybo-agh = "7"
LAYERSERIES_COMPAT_meta-zybo-agh = "master scarthgap"
BBDEBUG = "yes"
```
